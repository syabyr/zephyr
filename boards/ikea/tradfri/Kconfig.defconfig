## boards/ikea/tradfri/Kconfig.ikea_tradfri
```kconfig
# Copyright The Zephyr Project Contributors
# SPDX-License-Identifier: Apache-2.0

config BOARD_IKEA_TRADFRI
	select SOC_EFR32MG1P132F256GM32
```

## boards/ikea/tradfri/board.yml
```yaml
board:
  name: ikea_tradfri
  full_name: IKEA TRÅDFRI (EFR32MG1P)
  vendor: ikea
  socs:
    - name: efr32mg1p132f256gm32
```

## drivers/dma/Kconfig.ti_tm4c
```kconfig
# Copyright (c) 2026
# SPDX-License-Identifier: Apache-2.0

config DMA_TI_TM4C
	bool "TI TM4C uDMA controller driver"
	default y
	depends on DT_HAS_TI_TIVA_C_UDMA_ENABLED
	select USE_TIVAWARE_UDMA
	select USE_TIVAWARE_SYSCTL
	help
	  DMA driver for the micro DMA controller (uDMA) of TI TM4C
	  (Tiva C) microcontrollers. Channels 0..29 are hardwired to
	  peripheral request signals; channel 30 serves software
	  (memory to memory) requests. The driver reports completions
	  of software channels through the controller's own interrupt;
	  peripheral channels complete in the owning peripheral's
	  interrupt and are polled by their drivers.
```

## drivers/pwm/Kconfig.tivac
```kconfig
# Copyright (c) 2026
# SPDX-License-Identifier: Apache-2.0

config PWM_TIVAC
	bool "TI Tiva C GPTM PWM driver"
	default y
	depends on DT_HAS_TI_TIVA_C_GPTM_PWM_ENABLED
	help
	  Enable support for the PWM mode of the General-Purpose Timer
	  Module (GPTM) on TI Tiva C (TM4C) microcontrollers.

	  Each GPTM provides two independent PWM channels (Timer A and
	  Timer B) with up to 16-bit resolution (extendable to 24 bits
	  via the 8-bit prescaler).
```

## drivers/rtc/Kconfig.tivac
```kconfig
# Copyright (c) 2026
# SPDX-License-Identifier: Apache-2.0

config RTC_TIVAC
	bool "TI Tiva C Hibernation RTC driver"
	default y
	depends on DT_HAS_TI_TIVA_C_HIB_RTC_ENABLED
	help
	  Enable support for the RTC contained in the Hibernation module
	  of TI Tiva C (TM4C) microcontrollers.
```

## drivers/usb/udc/Kconfig.tiva_c
```kconfig
# Copyright (c) 2026
# SPDX-License-Identifier: Apache-2.0

config UDC_TIVA_C
	bool "TI Tiva C USB device controller driver"
	default y
	depends on DT_HAS_TI_TIVA_C_USBD_ENABLED
	select PINCTRL
	select USE_TIVAWARE_USB
	select EVENTS
	help
	  USB device controller driver for TI Tiva C (TM4C) microcontrollers.

	  The Tiva C series integrates a USB 2.0 Full-Speed OTG controller
	  with 8 bidirectional endpoints and 2 KB of dedicated endpoint RAM.

if UDC_TIVA_C

config UDC_TIVA_C_STACK_SIZE
	int "UDC driver internal thread stack size"
	default 1024
	help
	  Stack size for the UDC driver internal thread.

config UDC_TIVA_C_THREAD_PRIORITY
	int "UDC driver thread priority"
	default 8
	help
	  Priority of the UDC driver thread.

config UDC_TIVA_C_DMA
	bool "Use the integrated USB DMA controller"
	help
	  Move endpoint data with the 8-channel DMA controller integrated
	  in the MUSB IP instead of programmed FIFO I/O. EP0 stays PIO.
	  Transfers whose buffer is not word aligned fall back to PIO for
	  that transfer. DMA Mode 0 (one completion per packet) is used.

endif # UDC_TIVA_C
```

## dts/bindings/pwm/ti,tiva-c-gptm-pwm.yaml
```yaml
# SPDX-License-Identifier: Apache-2.0

description: TI Tiva C General-Purpose Timer (GPTM) PWM

compatible: "ti,tiva-c-gptm-pwm"

include: [pwm-controller.yaml, base.yaml, pinctrl-device.yaml]

properties:
  reg:
    required: true

  clock-frequency:
    type: int
    required: true
    description: |
      Clock frequency feeding the timer module, in Hz.
      Typically equal to the system clock (80000000 for TM4C123 at 80 MHz).

  "#pwm-cells":
    const: 3

pwm-cells:
  - channel
  - period
  - flags
```

## dts/bindings/rtc/ti,tiva-c-hib-rtc.yaml
```yaml
# SPDX-License-Identifier: Apache-2.0

description: TI Tiva C Hibernation RTC

compatible: "ti,tiva-c-hib-rtc"

include: [rtc-device.yaml, base.yaml]

properties:
  reg:
    required: true

  interrupts:
    required: true

  clock-frequency:
    type: int
    required: true
    description: |
      Clock frequency fed to the Hibernation module.  Typically 32768 Hz
      from an external low-frequency crystal.
```

## dts/bindings/usb/ti,tiva-c-usbd.yaml
```yaml
# Copyright (c) 2026
# SPDX-License-Identifier: Apache-2.0

description: |
  TI Tiva C USB device controller

  The Tiva C (TM4C) series integrates a USB 2.0 Full-Speed OTG controller
  with 8 bidirectional endpoints and 2 KB of dedicated endpoint RAM.

compatible: "ti,tiva-c-usbd"

include:
  - name: usb-ep.yaml
  - name: pinctrl-device.yaml

properties:
  reg:
    required: true

  interrupts:
    required: true

  peripheral-id:
    type: int
    required: true
    description: |
      USB peripheral instance number (0 for USB0).
      Used to enable the peripheral clock via SysCtlPeripheralEnable().
```

## soc/silabs/silabs_s1/efr32mg1p/Kconfig.soc
```kconfig
# Copyright The Zephyr Project Contributors
# SPDX-License-Identifier: Apache-2.0

config SOC_SERIES_EFR32MG1P
	bool
	select SOC_FAMILY_SILABS_S1
	help
	  Silicon Labs EFR32MG1P (Mighty Gecko) Series MCU

config SOC_EFR32MG1P132F256GM32
	bool
	select SOC_SERIES_EFR32MG1P

config SOC_SERIES
	default "efr32mg1p" if SOC_SERIES_EFR32MG1P

config SOC
	default "efr32mg1p132f256gm32" if SOC_EFR32MG1P132F256GM32
```
