/*
 * Copyright (c) 2026 Silicon Laboratories Inc.
 *
 * SPDX-License-Identifier: Apache-2.0
 */

#include <mem.h>
#include <silabs/xg1/xg1.dtsi>

/ {
	soc {
		compatible = "silabs,efr32mg1p132f256gm32", "silabs,efr32mg1p", "silabs,efr32",
			     "simple-bus";
	};
};

&flash0 {
	reg = <0 DT_SIZE_K(256)>;
	ranges = <0 0 DT_SIZE_K(256)>;
};

&sram0 {
	reg = <0x20000000 DT_SIZE_K(32)>;
};